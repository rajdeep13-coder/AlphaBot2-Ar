#include <Arduino.h>
#include <Wire.h>
#include <Adafruit_GFX.h>
#include <Adafruit_SSD1306.h>

//GENERATED BY AI ENTIRELY TO BE CHECKED AND TESTED 

// Maze Solver for AlphaBot V2-Ar
//
// Behavior:
// - Follows the right-hand rule while exploring a maze.
// - Records the turn sequence and compresses it into a shorter path.
// - Press a key in the Serial Monitor to switch to replay mode and run the
//   stored shortest path on the next attempt.
// - Uses the three IR line sensors, ultrasonic sensor, OLED, RGB LED, and buzzer.

// ---------------------------- Pin Mapping ----------------------------
const uint8_t MOTOR_LEFT_PWM = 5;
const uint8_t MOTOR_LEFT_DIR = 4;
const uint8_t MOTOR_RIGHT_PWM = 6;
const uint8_t MOTOR_RIGHT_DIR = 7;

const uint8_t LINE_LEFT_PIN = A0;
const uint8_t LINE_CENTER_PIN = A1;
const uint8_t LINE_RIGHT_PIN = A2;

const uint8_t ULTRASONIC_TRIG_PIN = 8;
const uint8_t ULTRASONIC_ECHO_PIN = 9;

const uint8_t BUZZER_PIN = 10;
const uint8_t RGB_PIN = 12;
const uint8_t RGB_COUNT = 3;

// OLED uses the shared I2C bus on A4/A5.
const uint8_t OLED_ADDR = 0x3C;

// ---------------------------- Libraries -----------------------------
Adafruit_SSD1306 display(128, 64, &Wire, -1);

// ----------------------- WS2812 (NeoPixel) ---------------------------
// The sketch uses a small built-in driver so it does not depend on an extra
// Arduino library installation.
const uint8_t RGB_BIT = 4; // D12 on Arduino Uno/Nano = PB4

// ------------------------- Tuning Parameters -------------------------
const int MOTOR_SPEED_FAST = 170;
const int MOTOR_SPEED_MEDIUM = 145;
const int MOTOR_SPEED_SLOW = 120;
const int MOTOR_SPEED_TURN = 150;
const int MOTOR_SPEED_SEARCH = 115;

const int LINE_THRESHOLD_LEFT = 650;
const int LINE_THRESHOLD_CENTER = 650;
const int LINE_THRESHOLD_RIGHT = 650;

const int INTERSECTION_DEBOUNCE_MS = 120;
const int TURN_TIME_90_MS = 330;
const int TURN_TIME_180_MS = 620;
const int STEP_TIME_MS = 40;
const int FRONT_WALL_DISTANCE_CM = 14;
const int PATH_MAX_LENGTH = 128;

// ----------------------------- States -------------------------------
enum Mode {
  MODE_EXPLORE,
  MODE_REPLAY,
  MODE_PAUSED
};

enum Move : char {
  MOVE_LEFT = 'L',
  MOVE_RIGHT = 'R',
  MOVE_STRAIGHT = 'S',
  MOVE_BACK = 'B'
};

Mode mode = MODE_EXPLORE;

char path[PATH_MAX_LENGTH];
uint8_t pathLength = 0;
uint8_t replayIndex = 0;

unsigned long lastIntersectionTime = 0;
unsigned long lastOLEDUpdate = 0;
unsigned long lastDebugPrint = 0;

int lastKnownError = 0;

// ------------------------- Utility Helpers --------------------------
static inline int clampSpeed(int speed) {
  if (speed < 0) return 0;
  if (speed > 255) return 255;
  return speed;
}

void setMotors(int leftSpeed, int rightSpeed, bool leftForward, bool rightForward) {
  digitalWrite(MOTOR_LEFT_DIR, leftForward ? HIGH : LOW);
  digitalWrite(MOTOR_RIGHT_DIR, rightForward ? HIGH : LOW);
  analogWrite(MOTOR_LEFT_PWM, clampSpeed(leftSpeed));
  analogWrite(MOTOR_RIGHT_PWM, clampSpeed(rightSpeed));
}

void driveForward(int speed) {
  setMotors(speed, speed, true, true);
}

void driveBackward(int speed) {
  setMotors(speed, speed, false, false);
}

void pivotLeft(int speed) {
  setMotors(speed, speed, false, true);
}

void pivotRight(int speed) {
  setMotors(speed, speed, true, false);
}

void stopMotors() {
  analogWrite(MOTOR_LEFT_PWM, 0);
  analogWrite(MOTOR_RIGHT_PWM, 0);
}

void beep(uint16_t durationMs) {
  tone(BUZZER_PIN, 1200, durationMs);
}

void setRGB(uint8_t r, uint8_t g, uint8_t b) {
  noInterrupts();

  DDRB |= _BV(RGB_BIT);

  for (uint8_t led = 0; led < RGB_COUNT; led++) {
    for (uint8_t bit = 0; bit < 8; bit++) {
      if (g & (0x80 >> bit)) {
        PORTB |= _BV(RGB_BIT);
        __asm__ __volatile__("nop\n\tnop\n\tnop\n\tnop\n\tnop\n");
        PORTB &= ~_BV(RGB_BIT);
      } else {
        PORTB |= _BV(RGB_BIT);
        __asm__ __volatile__("nop\n");
        PORTB &= ~_BV(RGB_BIT);
      }
    }

    for (uint8_t bit = 0; bit < 8; bit++) {
      if (r & (0x80 >> bit)) {
        PORTB |= _BV(RGB_BIT);
        __asm__ __volatile__("nop\n\tnop\n\tnop\n\tnop\n\tnop\n");
        PORTB &= ~_BV(RGB_BIT);
      } else {
        PORTB |= _BV(RGB_BIT);
        __asm__ __volatile__("nop\n");
        PORTB &= ~_BV(RGB_BIT);
      }
    }

    for (uint8_t bit = 0; bit < 8; bit++) {
      if (b & (0x80 >> bit)) {
        PORTB |= _BV(RGB_BIT);
        __asm__ __volatile__("nop\n\tnop\n\tnop\n\tnop\n\tnop\n");
        PORTB &= ~_BV(RGB_BIT);
      } else {
        PORTB |= _BV(RGB_BIT);
        __asm__ __volatile__("nop\n");
        PORTB &= ~_BV(RGB_BIT);
      }
    }
  }

  interrupts();
  delayMicroseconds(80);
}

int readLeftLine() {
  return analogRead(LINE_LEFT_PIN);
}

int readCenterLine() {
  return analogRead(LINE_CENTER_PIN);
}

int readRightLine() {
  return analogRead(LINE_RIGHT_PIN);
}

bool lineLeft() {
  return readLeftLine() > LINE_THRESHOLD_LEFT;
}

bool lineCenter() {
  return readCenterLine() > LINE_THRESHOLD_CENTER;
}

bool lineRight() {
  return readRightLine() > LINE_THRESHOLD_RIGHT;
}

int readFrontDistanceCm() {
  digitalWrite(ULTRASONIC_TRIG_PIN, LOW);
  delayMicroseconds(2);
  digitalWrite(ULTRASONIC_TRIG_PIN, HIGH);
  delayMicroseconds(10);
  digitalWrite(ULTRASONIC_TRIG_PIN, LOW);

  unsigned long duration = pulseIn(ULTRASONIC_ECHO_PIN, HIGH, 25000UL);
  if (duration == 0) {
    return 999;
  }

  return (int)(duration * 0.0343f / 2.0f);
}

bool isIntersection() {
  bool left = lineLeft();
  bool center = lineCenter();
  bool right = lineRight();

  // A junction typically lights more than one sensor.
  return (left && center) || (center && right) || (left && right) || (left && center && right);
}

void appendMove(char move) {
  if (pathLength >= PATH_MAX_LENGTH) {
    return;
  }

  path[pathLength++] = move;
}

char reducePattern(char first, char second, char third) {
  if (second != MOVE_BACK) {
    return 0;
  }

  if (first == MOVE_LEFT && third == MOVE_LEFT) return MOVE_STRAIGHT;
  if (first == MOVE_LEFT && third == MOVE_STRAIGHT) return MOVE_RIGHT;
  if (first == MOVE_LEFT && third == MOVE_RIGHT) return MOVE_BACK;

  if (first == MOVE_STRAIGHT && third == MOVE_LEFT) return MOVE_RIGHT;
  if (first == MOVE_STRAIGHT && third == MOVE_STRAIGHT) return MOVE_BACK;
  if (first == MOVE_STRAIGHT && third == MOVE_RIGHT) return MOVE_LEFT;

  if (first == MOVE_RIGHT && third == MOVE_LEFT) return MOVE_BACK;
  if (first == MOVE_RIGHT && third == MOVE_STRAIGHT) return MOVE_LEFT;
  if (first == MOVE_RIGHT && third == MOVE_RIGHT) return MOVE_STRAIGHT;

  return 0;
}

void simplifyPath() {
  if (pathLength < 3) {
    return;
  }

  char a = path[pathLength - 3];
  char b = path[pathLength - 2];
  char c = path[pathLength - 1];
  char replacement = reducePattern(a, b, c);

  if (replacement == 0) {
    return;
  }

  path[pathLength - 3] = replacement;
  pathLength -= 2;
}

void recordDecision(char move) {
  appendMove(move);
  simplifyPath();
}

void showStartupScreen() {
  display.clearDisplay();
  display.setTextColor(SSD1306_WHITE);
  display.setTextSize(1);
  display.setCursor(0, 0);
  display.println(F("AlphaBot Maze Solver"));
  display.println(F("Serial: send 'r'"));
  display.println(F("to replay path"));
  display.println(F("'p' pause, 'e' explore"));
  display.display();
}

void showStatus(const char *status, int distanceCm, bool left, bool center, bool right) {
  display.clearDisplay();
  display.setTextColor(SSD1306_WHITE);
  display.setTextSize(1);
  display.setCursor(0, 0);
  display.print(F("Mode: "));
  display.println(status);
  display.print(F("Dist: "));
  display.print(distanceCm);
  display.println(F(" cm"));
  display.print(F("L/C/R: "));
  display.print(left ? F("1") : F("0"));
  display.print(F(" "));
  display.print(center ? F("1") : F("0"));
  display.print(F(" "));
  display.println(right ? F("1") : F("0"));
  display.print(F("Path: "));
  display.println(pathLength);
  display.display();
}

void printPathToSerial() {
  Serial.print(F("Path length: "));
  Serial.println(pathLength);
  Serial.print(F("Path: "));

  for (uint8_t i = 0; i < pathLength; i++) {
    Serial.print(path[i]);
  }

  Serial.println();
}

void resetReplay() {
  replayIndex = 0;
}

void startReplayMode() {
  mode = MODE_REPLAY;
  resetReplay();
  beep(120);
  setRGB(0, 80, 180);
  Serial.println(F("Replay mode enabled"));
}

void startExploreMode() {
  mode = MODE_EXPLORE;
  resetReplay();
  beep(80);
  setRGB(0, 180, 0);
  Serial.println(F("Explore mode enabled"));
}

void pauseRobot() {
  mode = MODE_PAUSED;
  stopMotors();
  setRGB(180, 180, 0);
  Serial.println(F("Paused"));
}

void handleSerialCommand() {
  while (Serial.available() > 0) {
    char command = (char)Serial.read();

    if (command == 'r' || command == 'R') {
      startReplayMode();
    } else if (command == 'e' || command == 'E') {
      startExploreMode();
    } else if (command == 'p' || command == 'P') {
      pauseRobot();
    } else if (command == 'c' || command == 'C') {
      pathLength = 0;
      resetReplay();
      Serial.println(F("Path cleared"));
    } else if (command == 's' || command == 'S') {
      printPathToSerial();
    }
  }
}

void followLineExplore() {
  bool left = lineLeft();
  bool center = lineCenter();
  bool right = lineRight();
  int distanceCm = readFrontDistanceCm();

  if (millis() - lastIntersectionTime < INTERSECTION_DEBOUNCE_MS) {
    // Prevent double-recording while crossing a junction.
    if (center) {
      driveForward(MOTOR_SPEED_FAST);
    }
    return;
  }

  if (distanceCm <= FRONT_WALL_DISTANCE_CM && center) {
    // A wall directly ahead often indicates a dead end in line mazes.
    stopMotors();
    beep(150);
    setRGB(180, 0, 0);
    delay(100);
    recordDecision(MOVE_BACK);
    pivotLeft(MOTOR_SPEED_TURN);
    delay(TURN_TIME_180_MS);
    stopMotors();
    lastIntersectionTime = millis();
    return;
  }

  if (isIntersection()) {
    lastIntersectionTime = millis();

    if (right) {
      recordDecision(MOVE_RIGHT);
      beep(40);
      pivotRight(MOTOR_SPEED_TURN);
      delay(TURN_TIME_90_MS);
    } else if (center) {
      recordDecision(MOVE_STRAIGHT);
      driveForward(MOTOR_SPEED_FAST);
      delay(STEP_TIME_MS);
    } else if (left) {
      recordDecision(MOVE_LEFT);
      beep(40);
      pivotLeft(MOTOR_SPEED_TURN);
      delay(TURN_TIME_90_MS);
    } else {
      recordDecision(MOVE_BACK);
      pivotLeft(MOTOR_SPEED_TURN);
      delay(TURN_TIME_180_MS);
    }

    stopMotors();
    return;
  }

  if (center) {
    driveForward(MOTOR_SPEED_FAST);
    setRGB(0, 120, 0);
    lastKnownError = 0;
    return;
  }

  if (left) {
    setMotors(MOTOR_SPEED_SLOW, MOTOR_SPEED_MEDIUM, true, true);
    setRGB(0, 80, 150);
    lastKnownError = -1;
    return;
  }

  if (right) {
    setMotors(MOTOR_SPEED_MEDIUM, MOTOR_SPEED_SLOW, true, true);
    setRGB(150, 80, 0);
    lastKnownError = 1;
    return;
  }

  // Lost line: search in the last known direction.
  setRGB(180, 0, 180);
  if (lastKnownError < 0) {
    pivotLeft(MOTOR_SPEED_SEARCH);
  } else {
    pivotRight(MOTOR_SPEED_SEARCH);
  }
}

void replayPathStep() {
  if (replayIndex >= pathLength) {
    stopMotors();
    setRGB(0, 180, 0);
    beep(200);
    Serial.println(F("Replay complete"));
    mode = MODE_PAUSED;
    return;
  }

  char move = path[replayIndex++];
  Serial.print(F("Replay move: "));
  Serial.println(move);

  switch (move) {
    case MOVE_LEFT:
      pivotLeft(MOTOR_SPEED_TURN);
      delay(TURN_TIME_90_MS);
      break;
    case MOVE_RIGHT:
      pivotRight(MOTOR_SPEED_TURN);
      delay(TURN_TIME_90_MS);
      break;
    case MOVE_STRAIGHT:
      driveForward(MOTOR_SPEED_FAST);
      delay(250);
      break;
    case MOVE_BACK:
      pivotLeft(MOTOR_SPEED_TURN);
      delay(TURN_TIME_180_MS);
      break;
    default:
      break;
  }

  stopMotors();
  delay(40);
}

void updateOLEDStatus() {
  if (millis() - lastOLEDUpdate < 100) {
    return;
  }

  lastOLEDUpdate = millis();

  bool left = lineLeft();
  bool center = lineCenter();
  bool right = lineRight();
  int distanceCm = readFrontDistanceCm();

  const char *status = "Explore";
  if (mode == MODE_REPLAY) status = "Replay";
  if (mode == MODE_PAUSED) status = "Paused";

  showStatus(status, distanceCm, left, center, right);
}

void setup() {
  pinMode(MOTOR_LEFT_PWM, OUTPUT);
  pinMode(MOTOR_LEFT_DIR, OUTPUT);
  pinMode(MOTOR_RIGHT_PWM, OUTPUT);
  pinMode(MOTOR_RIGHT_DIR, OUTPUT);

  pinMode(LINE_LEFT_PIN, INPUT);
  pinMode(LINE_CENTER_PIN, INPUT);
  pinMode(LINE_RIGHT_PIN, INPUT);

  pinMode(ULTRASONIC_TRIG_PIN, OUTPUT);
  pinMode(ULTRASONIC_ECHO_PIN, INPUT);

  pinMode(BUZZER_PIN, OUTPUT);
  pinMode(RGB_PIN, OUTPUT);

  Serial.begin(115200);
  Wire.begin();

  if (!display.begin(SSD1306_SWITCHCAPVCC, OLED_ADDR)) {
    for (;;) {
      setRGB(180, 0, 0);
      delay(200);
      setRGB(0, 0, 0);
      delay(200);
    }
  }

  stopMotors();
  setRGB(0, 40, 120);
  showStartupScreen();
  Serial.println(F("Maze solver ready"));
  Serial.println(F("Use Serial commands: r=replay, e=explore, p=pause, c=clear, s=show path"));
}

void loop() {
  handleSerialCommand();

  if (mode == MODE_PAUSED) {
    updateOLEDStatus();
    delay(20);
    return;
  }

  if (mode == MODE_EXPLORE) {
    setRGB(0, 70, 0);
    followLineExplore();
  } else if (mode == MODE_REPLAY) {
    setRGB(0, 40, 120);
    replayPathStep();
  }

  if (millis() - lastDebugPrint > 500) {
    lastDebugPrint = millis();
    Serial.print(F("Mode="));
    Serial.print((mode == MODE_EXPLORE) ? F("EXPLORE") : (mode == MODE_REPLAY) ? F("REPLAY") : F("PAUSED"));
    Serial.print(F(" Path="));
    Serial.print(pathLength);
    Serial.print(F(" Dist="));
    Serial.println(readFrontDistanceCm());
  }

  updateOLEDStatus();
  delay(10);
}